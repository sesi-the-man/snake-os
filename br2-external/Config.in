## br2-external/configs/snake_pi0_defconfig
```kconfig
BR2_arm=y
BR2_arm1176jzf_s=y
BR2_DL_DIR="$(TOPDIR)/../.buildroot_dl"
BR2_GLOBAL_PATCH_DIR="$(BR2_EXTERNAL_RPI_SNAKE_PATH)/../patches"
BR2_CCACHE=y
BR2_CCACHE_DIR="$(TOPDIR)/../.buildroot-ccache"
BR2_REPRODUCIBLE=y
BR2_TOOLCHAIN_BUILDROOT_VENDOR="Buildroot"
BR2_TOOLCHAIN_BUILDROOT_GLIBC=y
BR2_PACKAGE_HOST_LINUX_HEADERS_CUSTOM_5_15=y
BR2_TARGET_GENERIC_HOSTNAME="snake"
BR2_TARGET_GENERIC_ISSUE="Snake"
BR2_ROOTFS_DEVICE_CREATION_DYNAMIC_MDEV=y
# BR2_TARGET_ENABLE_ROOT_LOGIN is not set
BR2_ROOTFS_OVERLAY="$(BR2_EXTERNAL_RPI_SNAKE_PATH)/rootfs-overlay"
BR2_ROOTFS_POST_BUILD_SCRIPT="$(BR2_EXTERNAL_RPI_SNAKE_PATH)/board/pi0/post-build.sh"
BR2_ROOTFS_POST_IMAGE_SCRIPT="$(BR2_EXTERNAL_RPI_SNAKE_PATH)/board/pi0/post-image.sh"
BR2_LINUX_KERNEL=y
BR2_LINUX_KERNEL_CUSTOM_TARBALL=y
BR2_LINUX_KERNEL_CUSTOM_TARBALL_LOCATION="$(call github,raspberrypi,linux,14b35093ca68bf2c81bbc90aace5007142b40b40)/linux-14b35093ca68bf2c81bbc90aace5007142b40b40.tar.gz"
BR2_LINUX_KERNEL_NEEDS_HOST_OPENSSL=y
BR2_LINUX_KERNEL_USE_CUSTOM_CONFIG=y
BR2_LINUX_KERNEL_CUSTOM_CONFIG_FILE="$(BR2_EXTERNAL_RPI_SNAKE_PATH)/board/pi0/kernel.config"
BR2_LINUX_KERNEL_LZ4=y
BR2_LINUX_KERNEL_DTS_SUPPORT=y
BR2_LINUX_KERNEL_INTREE_DTS_NAME="bcm2708-rpi-zero-w bcm2708-rpi-zero"
BR2_PACKAGE_BUSYBOX_CONFIG="$(BR2_EXTERNAL_RPI_SNAKE_PATH)/board/pi0/busybox.config"
BR2_PACKAGE_RPI_FIRMWARE=y
BR2_PACKAGE_RPI_FIRMWARE_BOOTCODE_BIN=y
BR2_PACKAGE_RPI_FIRMWARE_VARIANT_PI_CD=y
BR2_PACKAGE_RPI_FIRMWARE_CONFIG_FILE="$(BR2_EXTERNAL_RPI_SNAKE_PATH)/board/pi0/boot_config.txt"
BR2_PACKAGE_RPI_FIRMWARE_CMDLINE_FILE="$(BR2_EXTERNAL_RPI_SNAKE_PATH)/board/pi0/boot_cmdline.txt"
BR2_PACKAGE_SNAKE=y
BR2_TARGET_ROOTFS_CPIO_GZIP=y
BR2_TARGET_ROOTFS_INITRAMFS=y
BR2_PACKAGE_HOST_MTOOLS=y
# BR2_TARGET_ROOTFS_TAR is not set
```

## br2-external/package/snake/Config.in
```kconfig
config BR2_PACKAGE_SNAKE
	bool "snake"
	help
	  Tiny snake game for a small ST7789 SPI LCD (240x240 or 320x240)
	  with joystick and buttons. Plain C, no dependencies beyond libc.
```
